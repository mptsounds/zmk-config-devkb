## config/board/shield/odette_precursor_3x2/Kconfig.defconfig
```kconfig
if SHIELD_ODETTE_PRECURSOR_3X2 // must match kconfig.shield

  config ZMK_KEYBOARD_NAME
    default "Odette 3x2" // name this whatever you want, can't be more than 16 characters

  endif
```

## config/board/shield/odette_precursor_3x2/kconfig.shield
```kconfig
config SHIELD_ODETTE_PRECURSOR_3X2
  def_bool $(shields_list_contains, odette_precursor_3x2) # this name is referenced by build.yaml
```

## config/boards/shields/test1x2en/Kconfig.defconfig
```kconfig
if SHIELD_TEST1X2EN

config ZMK_KEYBOARD_NAME
    default "Test 1x2s e_nav"

config SPI
	default y

endif
```

## config/boards/shields/test1x2s/Kconfig.defconfig
```kconfig
if SHIELD_TEST1X2S

config ZMK_KEYBOARD_NAME
    default "Test 1x2 shift"

config SPI
	default y

endif
```

## config/boards/shields/test1x2se/Kconfig.defconfig
```kconfig
if SHIELD_TEST1X2SE

config ZMK_KEYBOARD_NAME
    default "Test 1x2s enc"

config SPI
	default y

endif
```

## config/boards/shields/test3x2/Kconfig.defconfig
```kconfig
if SHIELD_TEST3X2 // must match kconfig.shield

  config ZMK_KEYBOARD_NAME
    default "Test 3x2" // name this whatever you want, can't be more than 16 characters

endif
```
