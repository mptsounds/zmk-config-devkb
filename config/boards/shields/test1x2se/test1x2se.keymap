#include <behaviors.dtsi>
#include <dt-bindings/zmk/keys.h>
#include <dt-bindings/zmk/bt.h>

/ {  
    keymap {
        compatible = "zmk,keymap";

        default_layer {
            bindings = <
                &bootloader     &bt BT_CLR    &kp E
            >;

            sensor-bindings = <&inc_dec_kp LEFT RIGHT>; // press left & right keys

        }; 

    };
};
