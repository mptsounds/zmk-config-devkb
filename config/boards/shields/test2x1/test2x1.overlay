// Notes: this file's should match what's used in the .shield file's
// Since this is matrix wiring, we need a matrix transform macro, hence the "include" line.

#include <dt-bindings/zmk/matrix_transform.h>

/ {
	chosen {
		zmk,kscan = &default_kscan;
		zmk,matrix_transform = &default_transform;
	};

	default_transform: matrix_transform {
		compatible = "zmk,matrix-transform";
		columns = <1>;
		rows = <2>;
// | K1  | K2  |
// | K3  | K4  |

		map = <
RC(0,0)
RC(1,0)
		>;
	};

	default_kscan: kscan {
		compatible = "zmk,kscan-gpio-matrix";
		label = "KSCAN"; // can name it whatever

		diode-direction = "col2row";

		col-gpios
			= <&xiao_d 0 (GPIO_ACTIVE_HIGH)>     //Col0
//			, <&xiao_d 2 (GPIO_ACTIVE_HIGH)>     //Col1
			;

		row-gpios
			= <&xiao_d 1 (GPIO_ACTIVE_HIGH | GPIO_PULL_DOWN)>     //Row0
			= <&xiao_d 2 (GPIO_ACTIVE_HIGH | GPIO_PULL_DOWN)>     //Row1
			;

	};
   
};
